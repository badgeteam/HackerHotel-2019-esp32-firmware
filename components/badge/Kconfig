## components/badge/Kconfig
```kconfig
menu "Badge"

config SHA_BADGE_FIRMWARE_NAME
    string "Firmware version: name"
    default "bleeding edge"
    help
        Name of the firmware
        
config SHA_BADGE_FIRMWARE_BUILD
    int "Firmware version: build"
    default 0
    help
        Build number of the firmware

choice SHA_BADGE_REV
    prompt "Badge revision"
    default SHA_BADGE_V3
    help
        This option sets the type of badge for which the firmware will be compiled
        - Hackerhotel: The Hackerhotel 2019 badge.
        - Hackerhotel Prototype: SHA2017 with audio breakout.
        - Disobey: The disobey 2019 badge.
        - SHA2017 Rev1.0.0 Dev: Release candidate.
          (may 2017)
        - SHA2017  Rev1.0.0 Dev without the MPR121 chip.
        - SHA2017  Rev0.1.0 Dev: Improved badge.
          (february 2017)
        - SHA2017  Rev0.0.1 Dev: The original development badge.
          (december 2016)
        - Plain ESP32 hardware.

config HACKERHOTEL_BADGE_V1
    bool "Hackerhotel badge"
config HACKERHOTEL_BADGE_V0
    bool "Hackerhotel badge (Prototype)"
config DISOBEY
    bool "Disobey badge"
config SHA_BADGE_V3
    bool "SHA2017"
config SHA_BADGE_V3_LITE
    bool "SHA2017 badge without mpr121"
config SHA_BADGE_V2
    bool "SHA2017 badge (Development rev. 0.1.0)"
config SHA_BADGE_V1
    bool "SHA2017 badge (Development rev. 0.0.1)"
config SHA_BADGE_NONE
    bool "Plain ESP32"
endchoice

choice SHA_BADGE_EINK_DEFAULT_TYPE
    prompt "Badge e-ink default display type"
    default SHA_BADGE_EINK_DEF_DEPG0290B1
    depends on SHA_BADGE_V1 || SHA_BADGE_V2 || SHA_BADGE_V3 || SHA_BADGE_V3_LITE || HACKERHOTEL_BADGE_V0 || HACKERHOTEL_BADGE_V1
    help
        The DEPG0290B1 is the cheaper alternative.
        The GDEH029A1 was the original e-ink display.

config SHA_BADGE_EINK_DEF_DEPG0290B1
    bool "DEPG0290B1"
config SHA_BADGE_EINK_DEF_GDEH029A1
    bool "GDEH029A1"
endchoice

config SHA_BADGE_LEDS_WS2812
    bool "Using WS2812 LEDS instead of SK6812"
    depends on SHA_BADGE_V2 || SHA_BADGE_V3 || SHA_BADGE_V3_LITE || HACKERHOTEL_BADGE_V0 || HACKERHOTEL_BADGE_V1
    default n
    help
        On earlier developer boards, WS2812 leds were used
        instead of SK6812. This option modifies the data
        stream to emulate the SK6812 LEDS.

config SHA_BADGE_INPUT_DEBUG
    bool "Enable input debug messages"
    default n
    help
        Debugging

config SHA_BADGE_FXL6408_DEBUG
    bool "Enable FXL6408 port-expander debug messages"
    depends on SHA_BADGE_V2
    default n
    help
        Debugging

config SHA_BADGE_CPT112S_DEBUG
    bool "Enable CPT112S debug messages"
    depends on SHA_BADGE_V2
    default n
    help
        Debugging

config SHA_BADGE_MPR121_DEBUG
    bool "Enable MPR121 debug messages"
    depends on SHA_BADGE_V3 || HACKERHOTEL_BADGE_V0 || HACKERHOTEL_BADGE_V1
    default n
    help
        Debugging

config SHA_BADGE_MPR121_HARDCODE_BASELINE
    bool "Enable MPR121 hardcoded baseline values"
    depends on SHA_BADGE_V3 || HACKERHOTEL_BADGE_V0 || HACKERHOTEL_BADGE_V1
    default y
    help
        The baseline data was tested on one specific badge. Other badges
        might need different baselines. Disable this to use automatic
        base-line detection. (can cause buttons to not respond)

config SHA_BADGE_EINK_DEBUG
    bool "Enable eink debug messages"
    depends on SHA_BADGE_V1 || SHA_BADGE_V2 || SHA_BADGE_V3 || SHA_BADGE_V3_LITE || HACKERHOTEL_BADGE_V0 || HACKERHOTEL_BADGE_V1
    default n
    help
        Debugging

config SHA_BADGE_EINK_LUT_DEBUG
    bool "Enable eink lookup-table debug messages"
    depends on SHA_BADGE_V1 || SHA_BADGE_V2 || SHA_BADGE_V3 || SHA_BADGE_V3_LITE || HACKERHOTEL_BADGE_V0 || HACKERHOTEL_BADGE_V1
    default n
    help
        Debugging

config SHA_BADGE_POWER_DEBUG
    bool "Enable power/charging debug messages"
    depends on SHA_BADGE_V1 || SHA_BADGE_V2 || SHA_BADGE_V3 || SHA_BADGE_V3_LITE || HACKERHOTEL_BADGE_V0 || HACKERHOTEL_BADGE_V1
    default n
    help
        Debugging

endmenu
```

## components/bpp-if/Kconfig
```kconfig
menu "BPP"

config SHA_BPP_ENABLE
    bool "Enable BPP"
    default n
    help
        Enable passive firmware and read-only filesystem updates

endmenu
```

## components/display/Kconfig
```kconfig
menu "Display"

choice DISPLAY_TYPE
    prompt "Display type"
    default DISPLAY_NONE
config DISPLAY_NONE
    bool "No display"
config DISPLAY_EINK_DEPG0290B1
    bool "DEPG0290B1 - 2.9 inch eink - SPI"
config DISPLAY_EINK_GDEH029A1
    bool "GDEH029A1 - 2.9 inch eink - SPI"
config DISPLAY_EINK_WAVESHARE75
    bool "Waveshare - 7.5 inch eink - black & white - SPI"
config DISPLAY_EINK_WAVESHARE75B
    bool "Waveshare - 7.5 inch eink - black, white and red - SPI"
config DISPLAY_OLED_SSD1307_SPI
    bool "SSD1307 - OLED screen - SPI"
config DISPLAY_OLED_SSD1307_I2C
    bool "SSD1307 - OLED screen - I2C"
config DISPLAY_LCD_ERC12864
    bool "ERC12864 - LCD screen - I2C"
endchoice

choice DISPLAY_SPI_BUS
    prompt "SPI bus"
    default DISPLAY_SPI_BUS_VSPI
    depends on DISPLAY_EINK_DEPG0290B1 || DISPLAY_EINK_GDEH029A1 || ISPLAY_EINK_WAVESHARE75 || DISPLAY_EINK_WAVESHARE75B || DISPLAY_OLED_SSD1307_SPI
config DISPLAY_SPI_BUS_VSPI
    bool "VSPI bus"
config DISPLAY_SPI_BUS_HSPI
    bool "HSPI bus"
endchoice

config DISPLAY_PIN_CS
    int "Chip select pin"
    default 19
    depends on DISPLAY_EINK_DEPG0290B1 || DISPLAY_EINK_GDEH029A1 || ISPLAY_EINK_WAVESHARE75 || DISPLAY_EINK_WAVESHARE75B

config DISPLAY_PIN_DC
    int "Data/command pin"
    default 21
    depends on DISPLAY_EINK_DEPG0290B1 || DISPLAY_EINK_GDEH029A1 || ISPLAY_EINK_WAVESHARE75 || DISPLAY_EINK_WAVESHARE75B

config DISPLAY_PIN_RESET
    int "Reset pin"
    default 23
    depends on DISPLAY_EINK_DEPG0290B1 || DISPLAY_EINK_GDEH029A1 || ISPLAY_EINK_WAVESHARE75 || DISPLAY_EINK_WAVESHARE75B

config DISPLAY_PIN_BUSY
    int "Busy pin"
    default 22
    depends on DISPLAY_EINK_DEPG0290B1 || DISPLAY_EINK_GDEH029A1 || ISPLAY_EINK_WAVESHARE75 || DISPLAY_EINK_WAVESHARE75B


endmenu
```

## components/sha2017/Kconfig
```kconfig
menu "OTA firmware update"

config OTA_SERVER_NAME
    string "OTA server name"
    default "badge.team"
    help
        Hostname of the OTA server

config OTA_SERVER_PATH
    string "OTA server path"
    default "/firmware"
    help
        The path on the OTA server

endmenu
```
